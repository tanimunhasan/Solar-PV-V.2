
#define INPUT_VOLTAGE_SENSE_PIN 34
#define INPUT_CURRENT_SENSE_PIN 2
//#define TEMP_SENSE_PIN 4
#define VOLTAGE_SCALE  7.911 // R1+R2 / R2 // ( 47K + 6.8K ) / 6.8K
#define CURRENT_SCALE  1.5 // R4+R5 / R5 // ( 1K + 2K ) / 2K

double mVperAmp = 200; //Sensityvit of the sensor //  use 100 for 20A Module and 66 for 30A Module
double ACSoffset = 514; // Ideally it should be ( 0.1 x Vcc ) // measured value is 514mV
unsigned long last_time = 0;
unsigned long current_time = 0;
float power = 0 ; // Power in Watt
float energy = 0 ; // Emergy in Watt-Hour

float saving = 0; // cost saving



//========================= Setup Function ================================================

void setup() {
  Serial.begin(9600);


}

//========================= Loop Function ================================================


void loop()
{

  // read voltage and current
  float voltage = abs( return_voltage_value(INPUT_VOLTAGE_SENSE_PIN)) ;
  float current = abs( return_current_value(INPUT_CURRENT_SENSE_PIN)) ;

  // read temperature from DS18B20

  // Calculate power and energy
  power = current * voltage ; // calculate power in Watt
  last_time = current_time;
  current_time = millis();
  energy = energy +  power * (( current_time - last_time) / 3600000.0) ; // calculate power in Watt-Hour // 1 Hour = 60mins x 60 Secs x 1000 Milli Secs

  saving = 6.5 * ( energy / 1000 ); // 6.5 is cost per kWh // used just for example


  // ================= Display Data on Serial Monitor ================================================

  Serial.print("Voltage: ");
  Serial.println(voltage);
  Serial.print("Current: ");
  Serial.println(current);
  Serial.print("Power: ");
  Serial.println(power);
  Serial.print("Energy: ");
  Serial.println(energy);
  //Serial.print("Temp: ");
  
  Serial.println(voltage);
  delay(1000);

  // ================= Display Data on OLED Display ================================================

  // Display Solar Panel Voltage
//  display.setTextSize(1);
//  display.clearDisplay();
//  display.setCursor(10, 10);
//  display.print(voltage, 1);
//  display.print(" V");

  // Display Solar Panel Current

  //display.setCursor(70, 10);

  if (current > 0 && current < 1 )
  {
    Serial.print(current * 1000, 0);
    Serial.print(" mA");
    delay(100);
  }
  else
  {
    Serial.print(current, 2);
    Serial.print(" A");
    delay(100);
  }

  // Display Solar Panel Power in Watt

//  display.setTextSize(2);
//  display.setCursor(10, 25);
  Serial.print(power);
  Serial.print(" W");

  // Display Energy Generated by the Solar Panel
  //display.setCursor(10, 45);

  if ( energy >= 1000 )
  {
    Serial.print(energy / 1000, 3);
    Serial.print(" kWh");
    delay(100);
  }
  else
  {
    Serial.print(energy, 1);
    Serial.print(" Wh");
    delay(100);
  }
  


}

//========================= Function to Calculate Solar Panel Voltage ===================================

double return_voltage_value(int pin_no)
{
  double tmp = 0;
  double ADCVoltage = 0;
  double inputVoltage = 0;
  double avg = 0;
  for (int i = 0; i < 100; i++)
  {
    tmp = tmp + analogRead(pin_no);
  }
  avg = tmp / 100;
  ADCVoltage = ((avg * 3.3) / (4095)) + 0.184 ; // 0.184 is offset adjust by heat and try
  inputVoltage = ADCVoltage * VOLTAGE_SCALE;
  return inputVoltage;
}


//========================= Function to Calculate Solar Panel Current ===================================

double return_current_value(int pin_no)
{
  double tmp = 0;
  double avg = 0;
  double ADCVoltage = 0;
  double Amps = 0;
  for (int z = 0; z < 150; z++)
  {
    tmp = tmp + analogRead(pin_no);
  }
  avg = tmp / 150;
  ADCVoltage = ((avg * 3331) / 4095); // Gets you mV
  Amps = ((ADCVoltage * CURRENT_SCALE - ACSoffset ) / mVperAmp); // 1.5 is the scaling for voltage divider
  return Amps;
}
